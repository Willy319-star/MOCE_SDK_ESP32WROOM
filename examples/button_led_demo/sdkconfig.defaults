## examples/button_led_demo/sdkconfig.defaults
```kconfig
CONFIG_LOG_DEFAULT_LEVEL_INFO=y
CONFIG_ESPTOOLPY_FLASHSIZE_4MB=y
CONFIG_PARTITION_TABLE_SINGLE_APP=y
```

## examples/i2c_oled_demo/main/Kconfig.projbuild
```kconfig
menu "I2C OLED Demo"

choice OLED_DEMO_PROFILE
    prompt "OLED profile"
    default OLED_DEMO_PROFILE_096
    help
        Select the OLED module profile used by this demo.

config OLED_DEMO_PROFILE_096
    bool "0.96 inch SSD1306 128x64"

config OLED_DEMO_PROFILE_13
    bool "1.3 inch SH1106 128x64"

endchoice

endmenu
```

## examples/wifi_tcp_udp_demo/main/Kconfig.projbuild
```kconfig
menu "WiFi TCP UDP Demo"

    choice WIFI_TCP_UDP_DEMO_MODE
        prompt "Demo mode"
        default WIFI_TCP_UDP_DEMO_TCP_CLIENT

        config WIFI_TCP_UDP_DEMO_TCP_CLIENT
            bool "TCP client"

        config WIFI_TCP_UDP_DEMO_TCP_SERVER
            bool "TCP server"

        config WIFI_TCP_UDP_DEMO_UDP_CLIENT
            bool "UDP client"

        config WIFI_TCP_UDP_DEMO_UDP_SERVER
            bool "UDP server"
    endchoice

    config WIFI_TCP_UDP_DEMO_REMOTE_HOST
        string "Remote host"
        default "192.168.1.100"

    config WIFI_TCP_UDP_DEMO_REMOTE_PORT
        int "Remote port"
        default 9000

    config WIFI_TCP_UDP_DEMO_LOCAL_PORT
        int "Local listen port"
        default 9000

    config WIFI_TCP_UDP_DEMO_MESSAGE
        string "Message"
        default "hello from moce esp32 sdk"

endmenu
```
